## Config.in
```kconfig
# Uncomment lines if needed
source "$BR2_EXTERNAL_V3S3_PATH/package/libcedarc/Config.in"
source "$BR2_EXTERNAL_V3S3_PATH/package/h264enc_demo/Config.in"
source "$BR2_EXTERNAL_V3S3_PATH/package/esp/Config.in"
source "$BR2_EXTERNAL_V3S3_PATH/package/gst1-plugin-cedar/Config.in"
source "$BR2_EXTERNAL_V3S3_PATH/package/uboot_spi/Config.in"
source "$BR2_EXTERNAL_V3S3_PATH/package/gst1-rtsp-server-example/Config.in"

config BR2_EXTERNAL_ENABLE_INITRAMFS
	bool "Include pre-built initramfs image"
	default n
	help
		Enable the inclusion of an initramfs image in the rootfs. The initramfs
		image is built via 'make licheepi_zero_initramfs_defconfig'. For more
		information, see the Github repo.
```

## package/esp/Config.in
```kconfig
config BR2_PACKAGE_ESP8089
	bool "ESP8089 driver support"
	default y
	select BR2_PACKAGE_ESP
	help
		esp 8089 driver
```

## package/gst1-plugin-cedar/Config.in
```kconfig
config BR2_PACKAGE_GST1_PLUGIN_CEDAR
	bool "gst1-plugin-cedar"
	select BR2_PACKAGE_GST1_PLUGINS_BASE
	select BR2_PACKAGE_GST1_PLUGINS_BASE_PLUGIN_APP # runtime
	select BR2_PACKAGE_GST1_PLUGINS_GOOD
	select BR2_PACKAGE_GST1_PLUGINS_GOOD_PLUGIN_RTP # runtime
	select BR2_PACKAGE_GST1_PLUGINS_GOOD_PLUGIN_RTPMANAGER # runtime
	select BR2_PACKAGE_GST1_PLUGINS_GOOD_PLUGIN_UDP # runtime
	select BR2_PACKAGE_LIBV4L
	select BR2_PACKAGE_LIBCEDARC
	select BR2_PACKAGE_LIBCEDARC_ENCODER
	help
	  H264 cedar plugin on GStreamer.
```

## package/gst1-rtsp-server-example/Config.in
```kconfig
config BR2_PACKAGE_GST1_RTSP_SERVER_EXAMPLE
	bool "gst1-server-example"
	select BR2_PACKAGE_GST1_PLUGINS_BASE
	select BR2_PACKAGE_GST1_PLUGINS_BASE_PLUGIN_APP # runtime
	select BR2_PACKAGE_GST1_PLUGINS_GOOD
	select BR2_PACKAGE_GST1_PLUGINS_GOOD_PLUGIN_RTP # runtime
	select BR2_PACKAGE_GST1_PLUGINS_GOOD_PLUGIN_RTPMANAGER # runtime
	select BR2_PACKAGE_GST1_PLUGINS_GOOD_PLUGIN_UDP # runtime
	select BR2_PACKAGE_LIBV4L
	select BR2_PACKAGE_LIBCEDARC
	select BR2_PACKAGE_LIBCEDARC_ENCODER
	select BR2_PACKAGE_GST1_RTSP_SERVER
	help
	  H264 cedar plugin on GStreamer.
```

## package/uboot_spi/Config.in
```kconfig
config BR2_PACKAGE_UBOOT_SPI
	bool "uboot for spi flash"
	default y
	select BR2_UBOOT_SPI
	help
		uboot for spi flash
```
